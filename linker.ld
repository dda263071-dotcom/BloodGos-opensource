/* ============================================================
 * BloodG OS - Kernel Linker Script (FINAL)
 * Architecture : i386
 * Mode         : 32-bit Protected Mode
 * Load Address : 0x00100000 (1MB)
 * Entry Point  : start
 * ============================================================ */

OUTPUT_FORMAT("elf32-i386")
OUTPUT_ARCH(i386)
ENTRY(start)

/* ------------------------------------------------------------
 * Memory layout
 * ------------------------------------------------------------ */
SECTIONS
{
    /* Kernel load address */
    . = 0x00100000;

    /* --------------------------------------------------------
     * Text section (code)
     * -------------------------------------------------------- */
    .text ALIGN(4K) :
    {
        KEEP(*(.text.start))        /* kernel_entry.asm */
        *(.text*)
    }

    /* --------------------------------------------------------
     * Read-only data
     * -------------------------------------------------------- */
    .rodata ALIGN(4K) :
    {
        *(.rodata*)
    }

    /* --------------------------------------------------------
     * Initialized data
     * -------------------------------------------------------- */
    .data ALIGN(4K) :
    {
        *(.data*)
    }

    /* --------------------------------------------------------
     * Uninitialized data (BSS)
     * -------------------------------------------------------- */
    .bss ALIGN(4K) :
    {
        __bss_start = .;
        *(.bss*)
        *(COMMON)
        __bss_end = .;
    }

    /* --------------------------------------------------------
     * Kernel end marker
     * -------------------------------------------------------- */
    __kernel_end = .;
}
